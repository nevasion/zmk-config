## boards/shields/corne_nevasion/Kconfig.shield
```kconfig
# Copyright (c) 2020 Pete Johanson
# SPDX-License-Identifier: MIT

config SHIELD_corne_nevasion_LEFT
    def_bool $(shields_list_contains,corne_nevasion_left)

config SHIELD_corne_nevasion_RIGHT
    def_bool $(shields_list_contains,corne_nevasion_right)
```
